    "---",
    "--",
    "0%",
    "--:--",
    "--.--.----",
    "C",
    "F",
    "ppb",
    "Index",
    "HCHO",
    "AQI",
    "Initialiseren",
    "Frisse lucht - Alles goed",
    "Uitstekend",
    "Goed",
    "Matig",
    "Slecht",
    "UIT",
    "AAN",
    "OK",
    "ERR",
    "SYNC",
    "Verbonden",
    "AP-modus",
    "Fout",
    "Verbinden",
    "Uitgeschakeld",
    "Geen Wi-Fi",
    "Verbonden",
    "Fout",
    "Opnieuw (10m)",
    "Opnieuw (1h)",
    "Verbinden...",
    "AAN / UIT",
    "Elke 6h",
    "http://192.168.4.1/wifi",
    "http://aura.local/mqtt",
    "http://aura.local/theme",
    "CO gedetecteerd - Zorg voor ventilatie",
    "CO verhoogd - Direct ventileren",
    "CO gevaar! Nu evacueren",
    "CO2 zeer hoog! Ventileer nu",
    "CO2 hoog - Ventileer snel",
    "CO2 stijgt - Overweeg ventilatie",
    "PM2.5 zeer hoog! Zuiver - stop rook",
    "PM2.5 hoog - Zuiver - check bron",
    "PM2.5 verhoogd - Overweeg filter",
    "PM1 zeer hoog! Zuiver, stop verbranding",
    "PM1 hoog - Zuiver lucht, check bron",
    "PM1 verhoogd - Overweeg luchtreiniger",
    "PM10 zeer hoog! Zuiver - check bron",
    "PM10 hoog - Zuiver - minder stof",
    "PM10 verhoogd - Zuiver - minder stof",
    "HCHO zeer hoog! Ventileer - bron weg",
    "HCHO hoog - Ventileer - bron weg",
    "HCHO gedetecteerd - Check bronnen",
    "VOC zeer hoog! Bron zoeken - ventileer",
    "VOC hoog - Meer ventilatie",
    "NOx zeer hoog! Stop bron - ventileer",
    "NOx hoog - Gebruik afzuiging",
    "NOx verhoogd - Check koken/buiten",
    "Temp te koud! Verwarm nu",
    "Temp koud - Verwarm ruimte",
    "Temp wat koel - Meer warmte",
    "Temp te warm! Koel nu",
    "Temp warm - Ventileer / koel",
    "Temp wat warm - Meer lucht",
    "DP zeer laag! Bevochtig",
    "DP laag - Lucht kan droog zijn",
    "DP benauwd! Ontvochtig",
    "DP zeer hoog - Ventileer/ontvochtig",
    "DP hoog - Lucht kan benauwd zijn",
    "Luchtvocht. zeer laag! Bevochtig",
    "Luchtvocht. zeer laag - Gebruik bevochtiger",
    "Luchtvocht. laag - Overweeg bevochtiger",
    "Luchtvocht. zeer hoog! Ontvochtig",
    "Luchtvocht. zeer hoog - Ontvochtig",
    "Luchtvocht. hoog - Meer ventilatie",
    "INSTELLINGEN",
    "INSTELL",
    "TERUG",
    "TEMP OFFSET",
    "VOCHT OFFSET",
    "NACHTMODUS",
    "C / F",
    "HEAD STATUS",
    "WI-FI",
    "TIJD / DATUM",
    "THEMA KLEUR",
    "MQTT",
    "AUTO NACHT",
    "HERSTART",
    "FABRIEKS\nRESET",
    "CO2\nKALIBREREN",
    "INFO",
    "PUNTEN\nINDICATOREN",
    "ALARM\nKNIPPEREN",
    "VOC\nOPNIEUW LEREN",
    "ACHTERL.",
    "WI-FI INSTELL.",
    "Wi-Fi status:",
    "Wi-Fi instellen:\n- Druk op AAN / UIT\n- Verbind telefoon/pc met \"ProjectAura-Setup\".\n- Open http://192.168.4.1/wifi of scan QR.\n- Kies wifi-netwerk en voer wachtwoord in.\n",
    "SSID:",
    "IP:",
    "WIS\nWI-FI",
    "HERBIND",
    "START AP",
    "MQTT INSTELL.",
    "MQTT status:",
    "MQTT instellen:\n- Verbind Project Aura eerst met WI-FI\n- Open http://aura.local/mqtt of scan QR.",
    "Apparaat IP:",
    "Broker IP:",
    "Topic:",
    "HERBIND",
    "DATUM & TIJD",
    "TIJDZONE",
    "AUTO SYNC (NTP)",
    "TIJD INST.",
    "Uur:",
    "Minuten:",
    "DATUM INST.",
    "Dag:",
    "Maand:",
    "Jaar:",
    "TIJD",
    "TOEPASSEN",
    "RTC:",
    "WIFI:",
    "NTP:",
    "STATUS: ",
    "TEMP",
    "LUCHTVOCHT.",
    "DRUK",
    "OPWARMEN",
    "RESET VOC",
    "HERSTART",
    "RESET",
    "ANNULEREN",
    "VOC kalibratie resetten?",
    "VOC/NOx leren start opnieuw.\nMetingen kunnen uren instabiel zijn.",
    "Apparaat herstarten?",
    "Apparaat zal herstarten.\nMetingen pauzeren kort.",
    "Fabrieksreset?",
    "Wist Wi-Fi, offsets, thema's,\nroosters en VOC-status.\nDit kan niet ongedaan.",
    "THEMA:",
    "PERS.",
    "PRESETS",
    "VOORBEELD:",
    "Voor aangepast thema:\n- Verbind Project Aura eerst met WI-FI\n- Open http://aura.local/theme\n  of scan QR.\n- Opslaan via Terug",
    "AUTO NACHTMODUS",
    "Activeert \"Nachtmodus\" via schema.\n- Stel start en eind in.\n- Zet schakelaar op AAN.\n- Handmatige nachtmodus uit\n  wanneer Auto Nacht AAN is.",
    "STARTTIJD",
    "EINDTIJD",
    "SCHERM LICHT",
    "Apparaat meet lucht met scherm uit.\nSensoren blijven actief. Tik om te wekken.",
    "SLAAPSCHEMA",
    "WEKKEN BIJ ALARM",
    "AAN / UIT",
    "ENERGIE",
    "SLAAP OM",
    "WAKKER OM",
    "ALTIJD",
    "30 SEC",
    "1 MIN",
    "5 MIN",
    "CO2 kalibratie (Frisse lucht)",
    "KALIBREREN\nCO2",
    "- ASC (Auto Self-Calibration): AAN standaard.\n- Beste als CO2 wekelijks dicht bij buiten komt\n  (goede ventilatie / ruimte leeg).\n- ASC past langzaam aan (dagen, niet direct).\n- Met ASC AAN is handmatige\n  kalibratie meestal niet nodig.",
    "- Voed via powerbank.\n- Neem mee naar buiten in frisse lucht.\n- Weg van mensen, ramen, auto's, rook, vents.\n- Laat 10 min draaien (min 5).\n- Druk Kalibreer CO2 en beweeg niet.\n- Handmatige kalibratie alleen diagnose.\n- Max 1x / 6 maanden.\n- Referentie 420 ppm.\n- Foute omstandigheden verslechteren metingen.",
    "TIK OM DOOR TE GAAN",
    "BOOTDIAGNOSTIEK",
    "Systeem",
    "Sensoren",
    "App:",
    "MAC:",
    "Reset:",
    "Heap:",
    "Opslag:",
    "I2C:",
    "Touch:",
    "SEN66:",
    "SFA30:",
    "PCF8523:",
    "Fouten gedetecteerd",
    "TOON FOUTEN",
    "OK (config)",
    "OK (standaard)",
    "HERSTELD",
    "GEDETECTEERD",
    "MISLUKT",
    "STARTEN",
    "NIET GEVONDEN",
    "VERLOREN",
    "AH zeer laag! Bevochtig",
    "AH laag - Gebruik bevochtiger",
    "AH hoog - Schimmelrisico",
    "AH zeer hoog! Schimmel snel",
    "Temperatuur beinvloedt comfort, productiviteit en slaapkwaliteit. Drempels gebaseerd op ASHRAE 55 en WHO. Het optimale bereik helpt focus te houden en vermindert vermoeidheid. Extremes geven ongemak, slaperigheid of concentratieproblemen. Langdurige blootstelling kan de gezondheid schaden.",
    "Uitstekend: 20-25°C (68-77°F)\nIdeaal bereik voor comfort en productiviteit",
    "Acceptabel: 18-20°C of 25-26°C (64-68°F of 77-79°F)\nLicht buiten optimaal, nog comfortabel",
    "Oncomfortabel: 16-18°C of 26-28°C (61-64°F of 79-82°F)\nMerkbaar ongemak, lagere productiviteit",
    "Slecht: <16°C of >28°C (<61°F of >82°F)\nAanzienlijk ongemak, bijsturen",
    "VOC-index meet vluchtige organische stoffen uit verf, meubels, schoonmaakmiddelen en cosmetica. Gebaseerd op Sensirion SGP (schaal 1-500). Index 100 is basislucht. Hogere waarden betekenen meer VOC. Langdurige blootstelling kan hoofdpijn, oogirritatie en vermoeidheid geven. Ventileer bij hoge waarden. Blauwe indicator = sensor warmt op.",
    "Uitstekend: ≤150\nNormale binnenlucht, geen actie",
    "Acceptabel: 151-250\nVOC licht verhoogd, overweeg ventilatie",
    "Oncomfortabel: 251-350\nOdeurs mogelijk, ventilatie aanbevolen",
    "Slecht: >350\nHoofdpijn en irritatie waarschijnlijk, ventileer direct",
    "NOx-index meet stikstofoxiden uit verbranding: gasfornuizen, kachels, voertuigen, tabaksrook. Gebaseerd op Sensirion SGP (schaal 1-500). Hoge niveaus irriteren luchtwegen en verergeren astma. Gebruik afzuigkap bij gas. Blauwe indicator = sensor warmt op.",
    "Uitstekend: ≤50\nSchone lucht, geen verbrandingsbronnen",
    "Acceptabel: 51-100\nLichte stijging, zorg voor ventilatie",
    "Oncomfortabel: 101-200\nVerbrandingsbijproducten merkbaar, ventileer",
    "Slecht: >200\nHoge NOx-blootstelling, irritatie waarschijnlijk, bron zoeken",
    "Formaldehyde (HCHO) is een kankerverwekkende VOC uit spaanplaat, meubels, vloeren, lijmen en textiel. Drempels volgens WHO (~80 µg/m³ ≈ 65 ppb). Nieuwe meubels en renovaties zijn hoofdbronnen. Irriteert ogen, neus en keel. Niveaus dalen na verloop (uitgassing). Ventileer nieuwe ruimtes enkele weken.",
    "Uitstekend: <30 ppb\nVeilig niveau, geen irritatie verwacht",
    "Acceptabel: 30-60 ppb\nLage blootstelling, gevoeligen kunnen lichte irritatie merken",
    "Oncomfortabel: 60-100 ppb\nIrritatie ogen/keel mogelijk, ventileer meer",
    "Slecht: >100 ppb\nGezondheidsrisico, langdurige blootstelling schadelijk",
    "CO2 toont binnenluchtkwaliteit en ventilatie-efficientie. Drempels op ASHRAE en Duitse UBA. Buitenlucht is ~400 ppm. Boven 1000 ppm daalt cognitieve prestatie; boven 1500 ppm ontstaan slaperigheid en hoofdpijn. Goede ventilatie houdt CO2 laag voor focus en gezondheid.",
    "Uitstekend: <800 ppm\nOptimale luchtkwaliteit voor focus en productiviteit",
    "Acceptabel: 800-1000 ppm\nLichte daling van concentratie mogelijk",
    "Oncomfortabel: 1000-1500 ppm\nMerkbare vermoeidheid, lagere prestaties",
    "Slecht: >1500 ppm\nSlaperigheid, hoofdpijn, concentratieproblemen",
    "PM2.5 zijn fijne deeltjes die diep in longen en bloedbaan doordringen. Drempels gebaseerd op US EPA AQI en WHO. Langdurige blootstelling is gelinkt aan ademhalings- en hartziekten. Bronnen: koken, kaarsen, buitenlucht, rook. Houd binnenwaarden laag met filtratie en ventilatie.",
    "Uitstekend: ≤12 µg/m³\nSchone lucht, geen gezondheidseffect",
    "Acceptabel: >12-35 µg/m³\nGevoeligen kunnen lichte irritatie merken",
    "Oncomfortabel: >35-55 µg/m³\nMogelijk ademhalingsongemak, exposure beperken",
    "Slecht: >55 µg/m³\nGezondheidsrisico, langdurige blootstelling vermijden",
    "PM10 zijn grove deeltjes zoals stof, pollen en schimmelsporen. Drempels gebaseerd op US EPA AQI. Kunnen ogen, neus en keel irriteren. Minder schadelijk dan PM2.5 maar nog invloed op luchtwegen. Bronnen: stof, bouw, pollen, wegdeeltjes. Verminder met schoonmaken, filtratie en ramen dicht.",
    "Uitstekend: ≤54 µg/m³\nSchone lucht, geen irritatie verwacht",
    "Acceptabel: >54-154 µg/m³\nGevoeligen kunnen lichte irritatie voelen",
    "Oncomfortabel: >154-254 µg/m³\nIrritatie ogen/keel mogelijk, exposure beperken",
    "Slecht: >254 µg/m³\nAdemhalingsongemak waarschijnlijk, exposure beperken",
    "Drukverandering in 3 uur toont snelle weerwisselingen en directe effecten op welzijn. Snelle dalingen gaan vaak vooraf aan stormen en kunnen acute klachten geven bij gevoeligen: migraine, gewrichtspijn, duizeligheid. Handig voor korte planning. Bij plotselinge vermoeidheid of hoofdpijn: check deze waarde; drukval kan de oorzaak zijn.",
    "Uitstekend: <1.0 hPa\nStabiel weer, geen ongemak verwacht",
    "Acceptabel: 1.0-3.0 hPa\nWeer verandert, lichte vermoeidheid mogelijk",
    "Oncomfortabel: 3.0-6.0 hPa\nFront in aantocht, hoofdpijn en gewrichtspijn mogelijk",
    "Slecht: >6.0 hPa\nSnelle verandering, migraine en vermoeidheid waarschijnlijk",
    "Drukverandering over 24 uur laat trends zien en langdurige belasting van het lichaam. Grote schommelingen duiden op sterke fronten of stormen. Gevoeligen kunnen aanhoudende vermoeidheid, stemmingswisselingen of verergering van chronische pijn voelen. Handig om de dag te plannen en klachten te verwachten.",
    "Uitstekend: <2.0 hPa\nStabiel weer, comfortabel voor iedereen",
    "Acceptabel: 2.0-6.0 hPa\nWeer verandert, milde symptomen mogelijk",
    "Oncomfortabel: 6.0-10.0 hPa\nStorm/front, meer ongemak",
    "Slecht: >10.0 hPa\nZwaar weer, sterke symptomen mogelijk",
    "Luchtvochtigheid beinvloedt ademhalingscomfort, huid en gevoelstemperatuur. Drempels op ASHRAE 55 en EPA. Optimaal bereik (40-60%) voorkomt droge luchtwegen en remt schimmel. Lage luchtvochtigheid geeft droge huid, irritatie en statische elektriciteit. Hoge luchtvochtigheid bevordert schimmel, mijten en ongemak. Balans is essentieel.",
    "Uitstekend: 40-60%\nOptimaal comfort, gezond voor luchtwegen en huid",
    "Acceptabel: 30-40% of 60-65%\nLichte droogte of vocht, klein ongemak mogelijk",
    "Oncomfortabel: 20-30% of 65-70%\nDroge huid/irritatie of plakkerig gevoel",
    "Slecht: <20% of >70%\nGezondheidsrisico: luchtwegproblemen of schimmel",
    "Absolute vochtigheid meet de waterdampmassa in lucht (g/m³), onafhankelijk van temperatuur. Lage waarden drogen luchtwegen en huid uit. Hoge waarden maken koelen moeilijk en bevorderen schimmel. Handig voor ventilatie en vergelijking binnen/buiten. Optimaal bereik ondersteunt gezondheid en comfort.",
    "Uitstekend: 7-15 g/m³\nOptimale vochtigheid, comfortabele ademhaling",
    "Acceptabel: 5-7 of 15-18 g/m³\nIets te droog of vochtig, klein ongemak",
    "Oncomfortabel: 4-5 of 18-20 g/m³\nDroog of benauwd, ongemak waarschijnlijk",
    "Slecht: <4 of >20 g/m³\nZeer droog of vochtig, luchtweg- en huidproblemen",
    "Dauwpunt geeft vochtcomfort beter aan dan relatieve vochtigheid. Gebaseerd op NOAA-schaal. Het toont hoe benauwd of droog de lucht voelt. Laag dauwpunt betekent droge lucht die huid en luchtwegen irriteert. Hoog dauwpunt voelt plakkerig en drukkend, waardoor koelen moeilijker is. Ideaal bereik geeft comfortabele ademhaling en natuurlijke koeling.",
    "Uitstekend: 10-16°C (50-61°F)\nIdeaal comfort, prettige ademhaling",
    "Acceptabel: 8-10°C (46-50°F) of 16-18°C (61-64°F)\nLicht droog of vochtig, nog comfortabel",
    "Oncomfortabel: 5-8°C (41-46°F) of 18-21°C (64-70°F)\nDroog of benauwd, merkbaar ongemak",
    "Slecht: <5°C (<41°F) of >21°C (>70°F)\nTe droog of drukkend, ongemak voor gezondheid",
    "TEMPERATUUR",
    "FORMALDEHYDE",
    "RELATIEVE LUCHTVOCHTIGHEID",
    "ABSOLUTE LUCHTVOCHTIGHEID",
    "DAUWPUNT",
    "Schimmelrisico hangt af van luchtvochtigheid en temperatuur. Boven 70% met warme lucht stijgt het risico snel, vooral in hoeken, badkamers en slecht geventileerde ruimtes. Houd de luchtvochtigheid onder 60%.",
    "Uitstekend: 0-2\nLaag risico, schimmel onwaarschijnlijk",
    "Acceptabel: 3-4\nMatig risico, luchtvochtigheid blijven volgen",
    "Oncomfortabel: 5-7\nHoog risico, ontvochtigen en beter ventileren",
    "Slecht: 8-10\nKritiek risico, schimmel zeer waarschijnlijk, direct handelen",
    "SCHIMMELRISICO",
    "PM1 zijn ultrafijne deeltjes kleiner dan 1 micron die het diepst in de longen kunnen doordringen en deels in de bloedbaan komen. Typische bronnen zijn verbranding, verkeer, tabaksrook en kookdampen. Er zijn geen officiele EPA-limieten voor PM1, daarom zijn deze drempels afgeleid van PM2.5 met strengere banden.",
    "Uitstekend: <=10 ug/m3\nSchone lucht, geen verwacht gezondheidseffect",
    "Acceptabel: >10-25 ug/m3\nGevoelige personen kunnen lichte irritatie merken",
    "Oncomfortabel: >25-50 ug/m3\nMogelijk ademhalingsongemak, blootstelling beperken",
    "Slecht: >50 ug/m3\nGezondheidsrisico, langdurige blootstelling vermijden",
    "Koolmonoxide (CO) is een kleurloos en reukloos giftig gas door onvolledige verbranding. Typische bronnen: gasfornuis, verwarming, open haard, motoruitlaat en tabaksrook. CO vermindert zuurstoftransport in het bloed en kan binnen snel gevaarlijk worden. Onderhoud verbrandingstoestellen, ventileer goed en gebruik een CO-melder.",
    "Uitstekend: <9 ppm\nVeilig niveau, normale binnenlucht",
    "Acceptabel: 9-35 ppm\nVerhoogd, ventileer en beperk blootstelling",
    "Oncomfortabel: >35-100 ppm\nWaarschuwing, hoofdpijn en vermoeidheid mogelijk",
    "Slecht: >100 ppm\nGevaar! Meteen evacueren en ventileren",
    "PM0.5 telt ultrafijne deeltjes (0.3-0.5 um) die in de bloedbaan komen. Meting via laserverstrooiing in #/cm3. Bronnen: verbranding, koken, 3D-printen, kaarsen, vapen. Sensorbereik: 0-3000 #/cm3. Drempels houden rekening met sensornauwkeurigheid (+/-100 #/cm3) en typische stedelijke binnenwaarden.",
    "Excellent: <=250 #/cm3\nSchone lucht, ideaal voor slaap en lang verblijf",
    "Acceptable: >250-600 #/cm3\nNormale binnenlucht, geen actie nodig",
    "Uncomfortable: >600-1200 #/cm3\nBron gedetecteerd, ventileer of gebruik filter",
    "Poor: >1200 #/cm3\nHoge telling, zoek bron en verbeter luchtstroom",
    "Firmware-update\nUpdate wordt geinstalleerd...\nSchakel het apparaat niet uit.\nHet apparaat start automatisch opnieuw op.",
